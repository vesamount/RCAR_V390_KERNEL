## drivers/media/platform/soc_camera/Kconfig
```kconfig
config SOC_CAMERA
	tristate "SoC camera support"
	depends on VIDEO_V4L2 && HAS_DMA && I2C
	select VIDEOBUF2_CORE
	help
	  SoC Camera is a common API to several cameras, not connecting
	  over a bus like PCI or USB. For example some i2c camera connected
	  directly to the data bus of an SoC.

config SOC_CAMERA_SCALE_CROP
	tristate

config SOC_CAMERA_PLATFORM
	tristate "platform camera support"
	depends on SOC_CAMERA
	help
	  This is a generic SoC camera platform driver, useful for testing

config VIDEO_RCAR_VIN_LEGACY
	tristate "R-Car Video Input (VIN) support"
	depends on VIDEO_DEV && SOC_CAMERA
	depends on ARCH_RENESAS || COMPILE_TEST
	depends on HAS_DMA
	select VIDEOBUF2_DMA_CONTIG
	select SOC_CAMERA_SCALE_CROP
	select V4L2_FWNODE
	---help---
	  This is a v4l2 driver for the R-Car VIN Interface

config VIDEO_RCAR_VIN_LEGACY_DEBUG
	bool "Renesas VIN overflow debug messages"
	depends on VIDEO_RCAR_VIN_LEGACY
	---help---
	  Enable debug overflow messages on R-Car Video
	  Input driver.
	  If you set to enable, When an overflow occurred,
	  a debug overflow message is output.

config VIDEO_RCAR_CSI2_LEGACY
	tristate "R-Car MIPI CSI-2 Interface driver"
	depends on VIDEO_DEV && SOC_CAMERA && HAVE_CLK
	depends on ARCH_R8A7795 || ARCH_R8A7796 || ARCH_R8A77965 || COMPILE_TEST
	select V4L2_FWNODE
	---help---
	  This is a v4l2 driver for the R-Car CSI-2 Interface

config VIDEO_RCAR_ISP_LEGACY
	tristate "R-Car Image Signal Processing (ISP) support"
	depends on VIDEO_DEV && SOC_CAMERA
	depends on ARCH_RENESAS || COMPILE_TEST
	depends on HAS_DMA
	select VIDEOBUF2_DMA_CONTIG
	---help---
	  This is a v4l2 driver for the R-Car ISP Interface

config VIDEO_SH_MOBILE_CEU
	tristate "SuperH Mobile CEU Interface driver"
	depends on VIDEO_DEV && SOC_CAMERA && HAS_DMA && HAVE_CLK
	depends on ARCH_SHMOBILE || COMPILE_TEST
	depends on HAS_DMA
	select VIDEOBUF2_DMA_CONTIG
	select SOC_CAMERA_SCALE_CROP
	---help---
	  This is a v4l2 driver for the SuperH Mobile CEU Interface
```
