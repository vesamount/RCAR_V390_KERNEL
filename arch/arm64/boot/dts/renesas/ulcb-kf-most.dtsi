/*
 * Device Tree Source for the H3/M3ULCB Kingfisher board:
 *  this overrides GPS in favour MOST on GP5_24/GP5_25 R-CAR pins
 *
 * Copyright (C) 2017 Renesas Electronics Corp.
 * Copyright (C) 2017 Cogent Embedded, Inc.
 *
 * This file is licensed under the terms of the GNU General Public License
 * version 2.  This program is licensed "as is" without any warranty of any
 * kind, whether express or implied.
 */

&pfc {
	mlp_pins: mlp {
		groups = "mlb_3pin";
		function = "mlb_3pin";
	};
};

&scif1 {
	status = "disabled";
};

&mlp {
	pinctrl-0 = <&mlp_pins>;
	pinctrl-names = "default";
	status = "okay";

	clock-speed = "1024fs";
};
