/*
 * Device Tree Source for the H3ULCB.HAD board Alfa side
 *
 * Copyright (C) 2017 Renesas Electronics Corp.
 * Copyright (C) 2017 Cogent Embedded, Inc.
 *
 * This file is licensed under the terms of the GNU General Public License
 * version 2.  This program is licensed "as is" without any warranty of any
 * kind, whether express or implied.
 */

#include "r8a7795-h3ulcb-had.dtsi"

/ {
	model = "Renesas H3ULCB.HAD board Alfa side based on r8a7795";
};

&pciec0 {
	status = "okay";

	/* Root complex */
};
